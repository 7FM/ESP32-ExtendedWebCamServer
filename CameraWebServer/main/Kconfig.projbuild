## CameraWebServer/main/Kconfig.projbuild
```kconfig
menu "CameraWebServer Parameters"

    config CONFIG_FILE_PATH
        string "Config file path"
        default "config.txt"
        help
            File on the SD Card which contains config information like the WiFi SSID.

    config FALLBACK_WIFI_SSID
        string "Fallback WiFi SSID"
        default ""
        help
            Fallback WiFi SSID if it was not configured within the config file.
            Leave empty to disable if not set in config file.

    config FALLBACK_WIFI_PWD
        string "Fallback WiFi password"
        default ""
        help
            Fallback WiFi password if it was not configured within the config file.
            Leave empty to disable if not set in config file.
     
    config WIFI_MAXIMUM_RETRY
        int "Maximum connect retries"
        default 5
        help
            Set the Maximum retry to avoid station reconnecting to the AP unlimited when the AP is really inexistent.

    config FALLBACK_AP_SSID
        string "Fallback Access Point(AP) SSID"
        default ""
        help
            Fallback AP SSID for a Access Point that shall be created.
            Leave empty to disable if not set in config file.

    config FALLBACK_AP_PWD
        string "Fallback AP password"
        default ""
        help
            Fallback WiFi password for a Access Point that shall be created.
            Leave empty to disable if not set in config file.
            
    config FALLBACK_AP_IP_ADDR
        string "Fallback AP base ip address"
        default ""
        help
            Fallback AP base ip address for a Access Point that shall be created.
            Leave empty to disable if not set in config file.

    config FALLBACK_DEVICE_NAME
        string "Fallback device name"
        default "SPYCAM"
        help
            Fallback device name if it was not configured within the config file.

    menu "LED Illuminator"

        config LED_LEDC_PIN
            int "LED Illuminator GPIO Pin"
            range 0 33
            default 4
            help
                Set a pin to illuminate an onboard LED or IR Illuminator when streaming or taking snapshots.

        config LED_MAX_INTENSITY
            int "LED Maximum Intensity (0-255)"
            range 0 255
            default 255
            help
                Limit the maximum intensity of the LED while streaming to prevent overheating (0-255).

        choice LED_LEDC_SPEED_MODE
            bool "Select LEDC Timer Speed Mode"
            default LED_LEDC_LOW_SPEED_MODE
            help
                Select a speed mode for the LEDC channel 

            config LED_LEDC_LOW_SPEED_MODE  
                bool "LOW_SPEED_MODE"
            config LED_LEDC_HIGH_SPEED_MODE
                bool "HIGH_SPEED_MODE"
        endchoice

        config LED_LEDC_TIMER
            int "LEDC Timer"
            range 0 3
            default 1
            help
                Select the LEDC Timer (0-3)

        config LED_LEDC_CHANNEL
            int "LEDC Channel"
            range 0 7
            default 1
            help
                Select the LEDC Channel (0-7)
    endmenu

    config OTA_FEATURE
        bool "Enable Over the Air(OTA) updates"
        default y
        help
            Enable or disable OTA feature

    menu "Over the Air(OTA) Parameters"
        depends on OTA_FEATURE

        config FALLBACK_FIRMWARE_UPGRADE_URL
            string "Firmware Upgrade URL"
            default "https://192.168.42.42:42424/upgrade.bin"
            help
                Fallback URL of server which hosts the firmware image if non was specified in a config file.

        config CONFIG_SKIP_COMMON_NAME_CHECK
            bool "Skip the common name check during certificate verification."
            default n
            help
                This option is might be needed if you are using a local OTA server without a domain name.

        config OTA_RECV_TIMEOUT
            int "Connection Timeout"
            default 5000
            help
                Timeout in millis for connecting to the OTA server.
            
    endmenu

    menu "Timelapse Parameters"
        config CAM_TASK_TIMER_GROUP_NUM
            int "Timer group for timeplapse"
            default 1
            range 1 2
            help
                Timer group to use which is needed for the timelapse.

        config CAM_TASK_TIMER_NUM
            int "Timer number for timeplapse"
            default 1
            range 1 2
            help
                Timer number to use inside the timer group which is needed for the timelapse.

        config TMP_INDEX_FILE_PATH
            string "Temporary index file path"
            default ".tmpavi.idx"
            help
                Temporary file for the index needed to create a avi file during the timelapse.
    endmenu

    menu "Camera Pins"
        choice CAMERA_MODEL
            bool "Select Camera Pinout"
            default CAMERA_MODEL_AI_THINKER
            help
                Select Camera Pinout.

            config CAMERA_MODEL_WROVER_KIT
                bool "WROVER-KIT With OV2640 Module"
            config CAMERA_MODEL_ESP32_CAM_BOARD
                bool "ESP32 Camera Development Board"
            config CAMERA_MODEL_ESP_EYE
                bool "ESP_EYE DevKit"
            config CAMERA_MODEL_M5STACK_PSRAM
                bool "M5Stack Camera With PSRAM"
            config CAMERA_MODEL_M5STACK_WIDE
                bool "M5Stack Camera F (Wide)"
            config CAMERA_MODEL_AI_THINKER
                bool "ESP32-CAM by AI-Thinker"
            config CAMERA_MODEL_CUSTOM
                bool "Custom Camera Pinout"
        endchoice

        config CAMERA_PIN_PWDN
            depends on CAMERA_MODEL_CUSTOM
            int "Power Down pin"
            range -1 33
            default -1
            help
                Select Power Down pin or -1 for unmanaged.

        config CAMERA_PIN_RESET
            depends on CAMERA_MODEL_CUSTOM
            int "Reset pin"
            range -1 33
            default -1
            help
                Select Camera Reset pin or -1 for software reset.

        config CAMERA_PIN_XCLK
            depends on CAMERA_MODEL_CUSTOM
            int "XCLK pin"
            range 0 33
            default 21
            help
                Select Camera XCLK pin.

        config CAMERA_PIN_SIOD
            depends on CAMERA_MODEL_CUSTOM
            int "SIOD pin"
            range 0 33
            default 26
            help
                Select Camera SIOD pin.

        config CAMERA_PIN_SIOC
            depends on CAMERA_MODEL_CUSTOM
            int "SIOC pin"
            range 0 33
            default 27
            help
                Select Camera SIOC pin.

        config CAMERA_PIN_VSYNC
            depends on CAMERA_MODEL_CUSTOM
            int "VSYNC pin"
            range 0 39
            default 25
            help
                Select Camera VSYNC pin.

        config CAMERA_PIN_HREF
            depends on CAMERA_MODEL_CUSTOM
            int "HREF pin"
            range 0 39
            default 23
            help
                Select Camera HREF pin.

        config CAMERA_PIN_PCLK
            depends on CAMERA_MODEL_CUSTOM
            int "PCLK pin"
            range 0 39
            default 25
            help
                Select Camera PCLK pin.

        config CAMERA_PIN_Y2
            depends on CAMERA_MODEL_CUSTOM
            int "Y2 pin"
            range 0 39
            default 4
            help
                Select Camera Y2 pin.

        config CAMERA_PIN_Y3
            depends on CAMERA_MODEL_CUSTOM
            int "Y3 pin"
            range 0 39
            default 5
            help
                Select Camera Y3 pin.

        config CAMERA_PIN_Y4
            depends on CAMERA_MODEL_CUSTOM
            int "Y4 pin"
            range 0 39
            default 18
            help
                Select Camera Y4 pin.

        config CAMERA_PIN_Y5
            depends on CAMERA_MODEL_CUSTOM
            int "Y5 pin"
            range 0 39
            default 19
            help
                Select Camera Y5 pin.

        config CAMERA_PIN_Y6
            depends on CAMERA_MODEL_CUSTOM
            int "Y6 pin"
            range 0 39
            default 36
            help
                Select Camera Y6 pin.

        config CAMERA_PIN_Y7
            depends on CAMERA_MODEL_CUSTOM
            int "Y7 pin"
            range 0 39
            default 39
            help
                Select Camera Y7 pin.

        config CAMERA_PIN_Y8
            depends on CAMERA_MODEL_CUSTOM
            int "Y8 pin"
            range 0 39
            default 34
            help
                Select Camera Y8 pin.

        config CAMERA_PIN_Y9
            depends on CAMERA_MODEL_CUSTOM
            int "Y9 pin"
            range 0 39
            default 35
            help
                Select Camera Y9 pin.

    endmenu

    menu "Task Affinities & Priorites"

        menu "Timelapse Tasks"
            choice AVI_TASK_PINNED_TO_CORE
                bool "AVI file write task pinned to core"
                default AVI_TASK_CORE0
                help
                    Pin the AVI file writer task to a certain core(0/1). It can also be done automatically choosing NO_AFFINITY.

                config AVI_TASK_CORE0
                    bool "CORE0"
                config AVI_TASK_CORE1
                    bool "CORE1"
                config AVI_TASK_NO_AFFINITY
                    bool "NO_AFFINITY"
            endchoice

            choice CAM_FETCH_TASK_PINNED_TO_CORE
                bool "Camera frame fetch task pinned to core"
                default CAM_FETCH_TASK_CORE1
                help
                    Pin the camera frame fetcher task to a certain core(0/1). It can also be done automatically choosing NO_AFFINITY.

                config CAM_FETCH_TASK_CORE0
                    bool "CORE0"
                config CAM_FETCH_TASK_CORE1
                    bool "CORE1"
                config CAM_FETCH_TASK_NO_AFFINITY
                    bool "NO_AFFINITY"
            endchoice

        endmenu

        menu "HTTP Server Tasks"
            choice HTTP_CONTROL_TASK_PINNED_TO_CORE
                bool "Normal HTTP Server task pinned to core"
                default HTTP_CONTROL_TASK_CORE1
                help
                    Pin the HTTP control task to a certain core(0/1). It can also be done automatically choosing NO_AFFINITY.

                config HTTP_CONTROL_TASK_CORE0
                    bool "CORE0"
                config HTTP_CONTROL_TASK_CORE1
                    bool "CORE1"
                config HTTP_CONTROL_TASK_NO_AFFINITY
                    bool "NO_AFFINITY"
            endchoice

            choice HTTP_STREAM_TASK_PINNED_TO_CORE
                bool "Camera frame fetch task pinned to core"
                default HTTP_STREAM_TASK_CORE0
                help
                    Pin the HTTP stream task to a certain core(0/1). It can also be done automatically choosing NO_AFFINITY.

                config HTTP_STREAM_TASK_CORE0
                    bool "CORE0"
                config HTTP_STREAM_TASK_CORE1
                    bool "CORE1"
                config HTTP_STREAM_TASK_NO_AFFINITY
                    bool "NO_AFFINITY"
            endchoice

        endmenu

        menu "MDNS Tasks"
            choice MDNS_TASK_PINNED_TO_CORE
                bool "MDNS task pinned to core"
                default MDNS_TASK_CORE0
                help
                    Pin the MDNS task to a certain core(0/1). It can also be done automatically choosing NO_AFFINITY.

                config MDNS_TASK_CORE0
                    bool "CORE0"
                config MDNS_TASK_CORE1
                    bool "CORE1"
                config MDNS_TASK_NO_AFFINITY
                    bool "NO_AFFINITY"
            endchoice

        endmenu
    endmenu

endmenu
```
